/ {
    /* Активация I2C */
    &i2c0 {
        compatible = "nordic,nrf-twim";
        status = "okay";
        sda-pin = <XX>;  // Замените XX на ваш пин SDA (например, 15 для P0.15)
        scl-pin = <YY>;  // Замените YY на ваш пин SCL (например, 16 для P0.16)
        clock-frequency = <I2C_BITRATE_STANDARD>;  // 100 kHz (можно уменьшить до I2C_BITRATE_FAST для теста)
    };

    /* Настройка дисплея */
    &ssd1306 {
        compatible = "solomon,ssd1306fb";
        reg = <0x3C>;  // Адрес I2C (0x3C или 0x3D)
        label = "SSD1306";
        width = <128>;
        height = <32>;
        segment-offset = <0>;
        page-offset = <0>;
        display-offset = <0>;
        multiplex-ratio = <31>;
        prechargep = <0x22>;
        com-invdir;     // Если изображение перевёрнуто
        segment-remap;  // Если текст зеркальный
    };
};